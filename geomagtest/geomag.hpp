/*
MIT License

Copyright (c) 2019 Nathan Zimmerberg

Permission is hereby granted, free of charge, to any person obtaining a copy
of this software and associated documentation files (the "Software"), to deal
in the Software without restriction, including without limitation the rights
to use, copy, modify, merge, publish, distribute, sublicense, and/or sell
copies of the Software, and to permit persons to whom the Software is
furnished to do so, subject to the following conditions:

The above copyright notice and this permission notice shall be included in all
copies or substantial portions of the Software.

THE SOFTWARE IS PROVIDED "AS IS", WITHOUT WARRANTY OF ANY KIND, EXPRESS OR
IMPLIED, INCLUDING BUT NOT LIMITED TO THE WARRANTIES OF MERCHANTABILITY,
FITNESS FOR A PARTICULAR PURPOSE AND NONINFRINGEMENT. IN NO EVENT SHALL THE
AUTHORS OR COPYRIGHT HOLDERS BE LIABLE FOR ANY CLAIM, DAMAGES OR OTHER
LIABILITY, WHETHER IN AN ACTION OF CONTRACT, TORT OR OTHERWISE, ARISING FROM,
OUT OF OR IN CONNECTION WITH THE SOFTWARE OR THE USE OR OTHER DEALINGS IN THE
SOFTWARE.
*/


// ../geomag.hpp Generated by python script wmmcodeupdate.py
/** \file
 * \author Nathan Zimmerberg (nhz2@cornell.edu)
 * \date 23 OCT 2019
 * \brief Header-only library to calculate the magnetic field in the International Terrestrial Reference System(ITRS).
 * \details Designed to minimize ram usage for embedded systems.

The data from WMM2015, is not subject to copyright protection.
Modifications are:
  using ITRS coordinates,
  conversion from nT to T,
  Using unnormalized coefficents genrated by the python script wmmcodeupdate.py
  using a different spherical harmonics calculation, described in sections 3.2.4 and 3.2.5:
    Satellite Orbits Models, Methods and Applications,
      by Oliver Montenbruck and Eberhard Gill 2000
*/
#ifndef GEOMAG_HPP
#define GEOMAG_HPP

#include <math.h>

namespace geomag
{
constexpr int NMAX= 12;//order of the Model
constexpr int NUMCOF= (NMAX+1)*(NMAX+2)/2;//number of coefficents
struct ConstModel{
    float epoch;//decimal year
    int32_t Main_Field_Coeff_C[NUMCOF];
    int32_t Main_Field_Coeff_S[NUMCOF];
    int32_t Secular_Var_Coeff_C[NUMCOF];
    int32_t Secular_Var_Coeff_S[NUMCOF];
    /** Function for indexing the C spherical component n,m at dyear time.*/
    inline int32_t C(int n, int m, int32_t tau) const{
      int index= (((n+1) * n)>>1) + m - 1;
      return (Main_Field_Coeff_C[index]<<8) + tau*Secular_Var_Coeff_C[index];
    }
    /** Function for indexing the S spherical component n,m at dyear time.*/
    inline int32_t S(int n, int m, int32_t tau) const{
      int index= (((n+1) * n)>>1) + m - 1;
      return (Main_Field_Coeff_S[index]<<8) + tau*Secular_Var_Coeff_S[index];
    }
};
//mean radius of  ellipsoid in meters from section 1.2 of the WMM2015 Technical report
constexpr float EARTH_R= 6371200.0f;

typedef struct {
    float x;
    float y;
    float z;
} Vector;

inline int32_t fpmul(int32_t x, int32_t y){
    return (((int64_t)x)*((int64_t)y))>>16;
}

inline int32_t recsqrt(int x){
    static uint16_t LUT[27]= {65535, 46341, 37837, 32768, 29309, 26755, 24770, 23170, 21845, 20724, 19760, 18919, 18176, 17515, 16921, 16384, 15895, 15447, 15035, 14654, 14301, 13972, 13665, 13377, 13107, 12853, 12612};
    return LUT[x-1];//round(65536.0f/sqrtf(x));
}

/** Return the magnetic field in International Terrestrial Reference System coordinates, units Tesla.
 INPUT:
    position_itrs(Above the surface of earth): The location where the field is predicted, units m.
    dyear(should be around the epoch of the model): The decimal year, for example 2015.0
    WMM(): Magnetic field model to use.
 */
inline Vector GeoMag(float dyear, Vector position_itrs, const ConstModel& WMM){
    float x= position_itrs.x;
    float y= position_itrs.y;
    float z= position_itrs.z;
    int32_t px= 0;
    int32_t py= 0;
    int32_t pz= 0;
    int16_t tau= round((dyear-WMM.epoch)*256.0f);
    float r2= x*x+y*y+z*z;
    float r= sqrtf(r2);
    float scalea= EARTH_R/r2*65536.0f;
    int32_t a= round(z*scalea);
    int32_t b= round(EARTH_R*scalea);
    int32_t c= round(x*scalea);
    int32_t d= round(y*scalea);

    int n,m;
    //first m==0 row, just solve for the Vs
    int32_t Vtop= round(EARTH_R/r*65536.0f);//V0,0
    int32_t Wtop= 0;//W0,0
    int32_t Vprev= 0;
    int32_t Wprev= 0;
    int32_t Vnm= Vtop;
    int32_t Wnm= Wtop;
    int32_t temp;

    for ( m = 0; m < NMAX+2; m++)
    {
        int32_t sqrtmult= recsqrt(2*m+1);
        int32_t lastsqrtmult= 0;
        for (n = m; n < NMAX+2; n++)
        {
            if (n==m){
                if(m!=0){
                    int32_t nm_mult;
                    if(m==1){
                        nm_mult= 1L<<16;
                    }else{
                        nm_mult= fpmul((2*m-1)*recsqrt(2*m-1),recsqrt(2*m));
                    }
                    temp= Vtop;
                    Vtop= fpmul(nm_mult,fpmul(c,Vtop) - fpmul(d,Wtop));
                    Wtop= fpmul(nm_mult,fpmul(c,Wtop) + fpmul(d,temp));
                    Vprev= 0;
                    Wprev= 0;
                    Vnm= Vtop;
                    Wnm= Wtop;
                }
            }
            else{
                int32_t amult= fpmul(sqrtmult*(2*n-1),a);
                int32_t bmult= fpmul(fpmul((n+m-1)*sqrtmult,(n-m-1)*lastsqrtmult), b);
                temp= Vnm;
                Vnm= fpmul(amult,Vnm) - fpmul(bmult,Vprev);
                Vprev= temp;
                temp= Wnm;
                Wnm= fpmul(amult,Wnm) - fpmul(bmult,Wprev);
                Wprev= temp;
                lastsqrtmult= sqrtmult;
                sqrtmult= fpmul(recsqrt(n+1-m),recsqrt(n+1+m));
            }
            int32_t f;
            if (m<NMAX && n>=m+2){
                if(m==0){
                    f= fpmul(n*recsqrt(n), (n-1)*recsqrt((n-1)*2));
                }else{
                    f= fpmul((n-m)*recsqrt(n), (n-m-1)*recsqrt((n-m-1)))>>1;
                }
                px+= fpmul(f,fpmul(WMM.C(n-1,m+1,tau),Vnm)+fpmul(WMM.S(n-1,m+1,tau),Wnm));
                py+= fpmul(f,fpmul(-WMM.C(n-1,m+1,tau),Wnm)+fpmul(WMM.S(n-1,m+1,tau),Vnm));
            }
            if (n>=2 && m>=2){
                f= fpmul((n+m)*recsqrt(n+m), (n+m-1)*recsqrt(n+m-1))>>1;
                px+= fpmul(f,fpmul(-WMM.C(n-1,m-1,tau),Vnm)+fpmul(-WMM.S(n-1,m-1,tau),Wnm));
                py+= fpmul(f,fpmul(-WMM.C(n-1,m-1,tau),Wnm)+fpmul(WMM.S(n-1,m-1,tau),Vnm));
            }
            if (m==1 && n>=2){
                f= fpmul((n+1)*recsqrt(n+1), n*recsqrt(2*n));
                f= fpmul(f,-WMM.C(n-1,0,tau));
                px+= fpmul(f,Vnm);
                py+= fpmul(f,Wnm);
            }
            if (n>=2 && n>m){
                f= fpmul((n-m)*recsqrt(n-m), (n+m)*recsqrt(n+m));
                pz-= fpmul(f,fpmul(WMM.C(n-1,m,tau),Vnm)+fpmul(WMM.S(n-1,m,tau),Wnm));
            }
        }
    }
    return {float(-px>>8)*0.1f,float(-py>>8)*0.1f,float(-pz>>8)*0.1f};
}
// Model parameters
constexpr
#ifdef PROGMEM
    PROGMEM
#endif /* PROGMEM */
ConstModel WMM2015 = {2015.000000,
{-294385, -15011, -24453, 30125, 16766, 13511, -23523, 12256, 5819, 9072, 8137, 1203, -3350,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 -9, 0},
{0, 47962, 0, -28456, -6420, 0, -1153, 2450, -5383, 0, 2834, -1886, 1809,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 -2, 7},
{107, 179, -86, -33, 24, 31, -62, -4, -104, -4, 8, -92, 40,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 0, 0},
{0, -268, 0, -271, -133, 0, 84, -4, 23, 0, -6, 53, 30,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 0, 0}};

}
#endif /* GEOMAG_HPP */